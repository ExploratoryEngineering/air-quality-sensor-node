## CMakeLists.txt
```
# SPDX-License-Identifier: Apache-2.0

cmake_minimum_required(VERSION 3.13.1)
set(CMAKE_MODULE_PATH ${CMAKE_CURRENT_SOURCE_DIR}/nanopb/extra)
include($ENV{ZEPHYR_BASE}/cmake/app/boilerplate.cmake NO_POLICY_SCOPE)
project(aqnode)

# For nanoPB
find_package(Nanopb REQUIRED)
include_directories(${NANOPB_INCLUDE_DIRS})
nanopb_generate_cpp(PROTO_SRCS PROTO_HDRS ../common/protobuf/aq.proto)
nanopb_generate_cpp(PROTO_SRCS PROTO_HDRS ../common/protobuf/aqconfig.proto)
include_directories(${CMAKE_CURRENT_BINARY_DIR})
add_custom_target(generate_proto_sources DEPENDS ${PROTO_SRCS} ${PROTO_HDRS})
set_source_files_properties(${PROTO_SRCS} ${PROTO_HDRS}
    PROPERTIES GENERATED TRUE)

FILE(GLOB app_sources src/*.c)
target_sources(app PRIVATE ${app_sources} ${PROTO_SRCS} ${PROTO_HDRS})

set(CURDIR ${CMAKE_CURRENT_LIST_DIR} )

EXEC_PROGRAM(reto ARGS -r ${CURDIR} version OUTPUT_VARIABLE aq_version)
EXEC_PROGRAM(reto ARGS -r ${CURDIR} hashname OUTPUT_VARIABLE aq_name)

add_definitions(-DAQ_VERSION="${aq_version}" -DAQ_NAME="${aq_name}")

message( "Current dir: ${CURDIR}" )
message( "Version is ${aq_version}" )
message( "Name is ${aq_name}" )
```

## Kconfig
```
module = MAIN
module-str = MAIN
source "subsys/logging/Kconfig.template.log_config"

source "Kconfig.zephyr"

module = COMMS
module-str = COMMS
source "subsys/logging/Kconfig.template.log_config"

module = CHIPCAP2
module-str = CHIPCAP2
source "subsys/logging/Kconfig.template.log_config"

module = MAX14830
module-str = MAX14830
source "subsys/logging/Kconfig.template.log_config"

module = OPCN3
module-str = OPCN3
source "subsys/logging/Kconfig.template.log_config"

module = GPS
module-str = GPS
source "subsys/logging/Kconfig.template.log_config"

module = ADSL
module-str = ADSL
source "subsys/logging/Kconfig.template.log_config"

module = SARAN2
module-str = SARAN2
source "subsys/logging/Kconfig.template.log_config"

module = EEGPIO
module-str = EEGPIO
source "subsys/logging/Kconfig.template.log_config"

module = EEI2C
module-str = EEI2C
source "subsys/logging/Kconfig.template.log_config"

module = EESPI
module-str = EESPI
source "subsys/logging/Kconfig.template.log_config"

module = FOTA
module-str = FOTA
source "subsys/logging/Kconfig.template.log_config"
```

## prj.conf
```kconfig
# Basics
CONFIG_DEBUG=y

# Logging
CONFIG_LOG=y
CONFIG_LOG_IMMEDIATE=n
CONFIG_LOG_STRDUP_BUF_COUNT=30
CONFIG_MAIN_LOG_LEVEL_DBG=y
CONFIG_GPS_LOG_LEVEL_INF=y
CONFIG_MAX14830_LOG_LEVEL_INF=y
CONFIG_EEGPIO_LOG_LEVEL_INF=y
CONFIG_CHIPCAP2_LOG_LEVEL_INF=y
CONFIG_ADSL_LOG_LEVEL_INF=y
CONFIG_COMMS_LOG_LEVEL_INF=y
CONFIG_OPCN3_LOG_LEVEL_INF=y
CONFIG_EEI2C_LOG_LEVEL_INF=y
CONFIG_EESPI_LOG_LEVEL_INF=y
CONFIG_FOTA_LOG_LEVEL_DBG=y
CONFIG_SARAN2_LOG_LEVEL_INF=y

CONFIG_COAP_LOG_LEVEL_DBG=y
CONFIG_NET_LOG=y

# Console
CONFIG_CONSOLE=y
CONFIG_STDOUT_CONSOLE=y
CONFIG_RTT_CONSOLE=y
CONFIG_UART_CONSOLE=n
CONFIG_USE_SEGGER_RTT=y
CONFIG_HAS_SEGGER_RTT=y

# GPIO config
CONFIG_GPIO_AS_PINRESET=n
CONFIG_GPIO=y

# I2C config
CONFIG_I2C=y
CONFIG_I2C_NRFX=y
CONFIG_I2C_0=y

# SPI config
CONFIG_SPI=y
CONFIG_SPI_1=y
CONFIG_SPI_LOG_LEVEL_WRN=y

# UART setup
CONFIG_SERIAL=y
CONFIG_UART_INTERRUPT_DRIVEN=y

# System
CONFIG_HW_STACK_PROTECTION=y
CONFIG_HEAP_MEM_POOL_SIZE=16384
CONFIG_SYSTEM_WORKQUEUE_STACK_SIZE=8192
CONFIG_NEWLIB_LIBC=y
CONFIG_NUM_COOP_PRIORITIES=10
CONFIG_NUM_PREEMPT_PRIORITIES=10
CONFIG_MAIN_STACK_SIZE=16384

# MCUBoot and flash - needed by LwM2M FOTA
CONFIG_BOOTLOADER_MCUBOOT=y
CONFIG_FLASH_PAGE_LAYOUT=y
CONFIG_FLASH=y
CONFIG_IMG_MANAGER=y
CONFIG_MCUBOOT_IMG_MANAGER=y
CONFIG_MPU_ALLOW_FLASH_WRITE=y
CONFIG_REBOOT=y

# Non-volatile storage (for config parameters)
CONFIG_NVS=y
CONFIG_NVS_LOG_LEVEL_DBG=y

# This is enabled by default but we don't need it
CONFIG_CHARACTER_FRAMEBUFFER=n

# Ring buffer -used when reading UART and processing commands from
# the modem
CONFIG_RING_BUFFER=y

# Network config
CONFIG_NET_BUF_RX_COUNT=1
CONFIG_NET_BUF_TX_COUNT=1
CONFIG_NET_IPV4=n
CONFIG_NET_IPV6=n
CONFIG_NET_L2_DUMMY=y
CONFIG_NET_NATIVE_UDP=n
CONFIG_NET_NATIVE=n
CONFIG_NET_OFFLOAD=y
CONFIG_NET_RX_STACK_SIZE=512
CONFIG_NET_SOCKETS_OFFLOAD=y
CONFIG_NET_SOCKETS_POSIX_NAMES=y
CONFIG_NET_SOCKETS=y
CONFIG_NET_STATISTICS=n
CONFIG_NET_TX_STACK_SIZE=512
CONFIG_NET_UDP=y
CONFIG_NETWORKING=y

# CoAP config - needed by LwM2M
CONFIG_COAP=y
#CONFIG_COAP_EXTENDED_OPTIONS_LEN_VALUE=17
#CONFIG_COAP_EXTENDED_OPTIONS_LEN=y
#CONFIG_COAP_INIT_ACK_TIMEOUT_MS=20000

CONFIG_WATCHDOG=y
```

## boards/nrf52_pca10040.conf
```kconfig
CONFIG_GPIO_NRFX=y
CONFIG_HAS_HW_NRF_GPIO0=y
CONFIG_HAS_HW_NRF_TWI0=y
CONFIG_I2C_NRFX=y
CONFIG_SPI_NRFX=y
CONFIG_HAS_DTS_I2C=y
CONFIG_I2C_0_NRF_TWI=y
CONFIG_UART_0_NRF_UART=y
```

## nrf52_pca10040.overlay
```dts
/* SPDX-License-Identifier: Apache-2.0 */

&i2c0 {
	status = "okay";
	compatible = "nordic,nrf-twi";
    sda-pin = <27>;
	scl-pin = <26>;
	clock-frequency = <I2C_BITRATE_STANDARD>;
};

&spi1 {
	status = "okay";
	compatible = "nordic,nrf-spi";
	mosi-pin = <23>;
	sck-pin = <25>;
	miso-pin = <24>;
};

&uart0 {
 status = "okay";
 compatible = "nordic,nrf-uart";
 current-speed = <9600>;
 tx-pin = <7>;
 rx-pin = <8>;
 };
```

## src/main.c
```c
/*
**   Copyright 2020 Telenor Digital AS
**
**  Licensed under the Apache License, Version 2.0 (the "License");
**  you may not use this file except in compliance with the License.
**  You may obtain a copy of the License at
**
**      http://www.apache.org/licenses/LICENSE-2.0
**
**  Unless required by applicable law or agreed to in writing, software
**  distributed under the License is distributed on an "AS IS" BASIS,
**  WITHOUT WARRANTIES OR CONDITIONS OF ANY KIND, either express or implied.
**  See the License for the specific language governing permissions and
**  limitations under the License.
*/

#include <zephyr.h>
#include <stdio.h>
#include <logging/log.h>
#include <net/socket.h>
#include <misc/reboot.h>
#include <drivers/watchdog.h>

#include "gps.h"
#include "messagebuffer.h"
#include "version.h"
#include "init.h"
#include "chipcap2.h"
#include "n2_offload.h"
#include "fota.h"
#include "comms.h"
#include "config.h"
#include "config_message.h"


#define LOG_LEVEL CONFIG_MAIN_LOG_LEVEL
LOG_MODULE_REGISTER(MAIN);

#define SEND_INTERVAL_SEC 30
#define FOTA_CHECK_INTERVAL_SEC 500

#define FOTA_COUNTER (FOTA_CHECK_INTERVAL_SEC / SEND_INTERVAL_SEC)

#define MAX_SEND_BUFFER 450
static uint8_t buffer[MAX_SEND_BUFFER];

#define MAX_COMMAND_BUFFER 256
static uint8_t command_buffer[MAX_COMMAND_BUFFER];

extern char CURRENT_COAP_BUFFER[128];
extern apn_config CURRENT_APN_CONFIG;


void dump_buffer(uint8_t * buf, int len)
{
	LOG_INF("Dumping buffer: %d bytes", len);
	for (int i=0; i<len; i++)
	{
		LOG_INF("%02X", *buf++);
	}
}



// Watchdog
#define WDT_DEV_NAME DT_WDT_0_NAME
struct device *wdt;
int wdt_channel_id;


static void wdt_callback(struct device *wdt_dev, int channel_id)
{
	LOG_WRN("Watchdog timer expired. Rebooting in 1 second");
	k_sleep(1000);
	sys_reboot(0);
}


void watchdog_init()
{
	int err;
	struct wdt_timeout_cfg wdt_config;

	LOG_INF("Initializing watchdog");

	wdt = device_get_binding(WDT_DEV_NAME);
	if (!wdt) {
		printk("Cannot get WDT device\n");
		return;
	}

	// Reset SoC when watchdog timer expires.
	wdt_config.flags = WDT_FLAG_RESET_SOC;

	// Expire watchdog after two hours. 
	wdt_config.window.min = 0U;
	wdt_config.window.max = 7200000U;

	// Set up watchdog callback. Jump into it when watchdog expired.
	wdt_config.callback = wdt_callback;

	wdt_channel_id = wdt_install_timeout(wdt, &wdt_config);
	if (wdt_channel_id == -ENOTSUP) 
	{
		wdt_config.callback = NULL;
		wdt_channel_id = wdt_install_timeout(wdt, &wdt_config);
	}
	if (wdt_channel_id < 0) 
	{
		LOG_ERR("Watchdog install error");
		return;
	}

	err = wdt_setup(wdt, 0);
	if (err < 0) 
	{
		LOG_ERR("Watchdog setup error\n");
		return;
	}

	LOG_INF("Watchdog channel id: %d", wdt_channel_id);
}


void do_the_hetzner_ping()
{
	LOG_INF("----------------------");
	LOG_INF("Doing the Hetzner ping");
	LOG_INF("----------------------");

	// Select temporary APN. Bail out if we can't make contact
	if (!select_ping_apn())
		return;

	// Create socket
	int sock = socket(AF_INET, SOCK_DGRAM, IPPROTO_UDP);
	if (sock < 0)
	{
		LOG_ERR("Error opening socket: %d", sock);
		k_sleep(1000);
		sys_reboot(0);
	}
	
	static struct sockaddr_in remote_addr_ping = {
		sin_family : AF_INET,
	};
	remote_addr_ping.sin_port = htons(1234);
	net_addr_pton(AF_INET, CURRENT_COAP_BUFFER, &remote_addr_ping.sin_addr);

	char PING_BUFFER[128];

	int ping_bytes = 0;
	if (!encode_ping(PING_BUFFER, sizeof(PING_BUFFER), &ping_bytes))
	{
		LOG_ERR("Failed encoding PING message. Bailing out");
		return;
	}
	LOG_INF("Encoded protobuf PING: %d bytes", ping_bytes);

	for (int i=0; i<PING_RETRIES; i++) 
	{
		LOG_INF("PING attempts: %d", i);
		int err = sendto(sock, PING_BUFFER, ping_bytes, 0, (struct sockaddr *)&remote_addr_ping, sizeof(remote_addr_ping));
		if (err < 0)
		{
			LOG_ERR("Unable to send data to PING server: %d", err);
		}
		k_sleep(1000);
		int received = recvfrom(sock, command_buffer, sizeof(command_buffer), 0, NULL, NULL);
		if (received > 0)
		{
			LOG_INF("----------------------------------------------");
			LOG_INF("RECEIVED CONFIGURAION request from PING server");
			LOG_INF("----------------------------------------------");
			// A correctly decoded message that contains parameters that differ from those
			// stored in NVS will force a reboot and new APN scan
			// a negative return value indicates invalid or unchanged parameters,
			// which means we don't need to retry
			int rc = decode_config_message(command_buffer, received);
			if (rc != 0)
			{
				close (sock);
				return;
			}
		}
		k_sleep(PING_RETRY_DELAY_MS);
	}

	LOG_INF("PING timeout. No reply from PING server");

	close (sock);
}



void main(void)
{
 	init_board();
	watchdog_init();

	k_sleep(1000);

	LOG_INF("This is the AQ node with version %s (%s)", AQ_VERSION, AQ_NAME);

	cc2_init();
	gps_init();
	opc_init();

	LOG_INF("Waiting for modem");
	wait_for_sockets();
	LOG_DBG("Ready to run");

	do_the_hetzner_ping();

	select_active_apn();

	fota_init();
	if (fota_run())
	{
		k_sleep(1000);
	}

	// Create config socket
	int config_sock = socket(AF_INET, SOCK_DGRAM, IPPROTO_UDP);
	if (config_sock < 0)
	{
		LOG_ERR("Error opening socket: %d", config_sock);
		k_sleep(1000);
		sys_reboot(0);
	}
	
	static struct sockaddr_in remote_addr_config = {
		sin_family : AF_INET,
	};
	remote_addr_config.sin_port = htons(1234);
	net_addr_pton(AF_INET, CURRENT_COAP_BUFFER, &remote_addr_config.sin_addr);


	
	// Main loop
	int fota_interval = 0;
	while (true)
	{
		// modem_restart_without_triggering_network_signalling_storm_but_hopefully_picking_up_the_correct_cell___maybe();

		wdt_feed(wdt, wdt_channel_id); // Tickle and feed the watchdog

		// Check if we have received any configuration messsages via the config port
		int received = recvfrom(config_sock, command_buffer, sizeof(command_buffer), 0, NULL, NULL);
		if (received > 0)
		{
			LOG_INF("---------------------------------");
			LOG_INF("CONFIG message received. %d bytes", received);
			LOG_INF("---------------------------------");
			decode_config_message(command_buffer, received);
		}

		// Create send socket
		int sock = socket(AF_INET, SOCK_DGRAM, IPPROTO_UDP);
		if (sock < 0)
		{
			LOG_ERR("Error opening socket: %d", sock);
			k_sleep(1000);
			sys_reboot(0);
		}
		
		static struct sockaddr_in remote_addr = {
			sin_family : AF_INET,
		};
		remote_addr.sin_port = htons(1234);
		net_addr_pton(AF_INET, CURRENT_COAP_BUFFER, &remote_addr.sin_addr);



		LOG_DBG("Sampling sensors");
		SENSOR_NODE_MESSAGE last_message;

		opc_n3_sample_data();
		opc_n3_get_sample(&last_message.opc_sample);

		adc_sample_data();
		adc_get_sample(&last_message.afe3_sample);

		cc2_sample_data();
		cc2_get_sample(&last_message.cc2_sample);

		gps_get_sample(&last_message.gps_fix);

		last_message.uptime = k_uptime_get() / 1000;

		int len = mb_encode(&last_message, buffer, MAX_SEND_BUFFER);
		LOG_DBG("Sample complete, encoded buffer = %d bytes", len);


	#if 0
		mb_hex_dump_message(buffer, len);
	#endif

/*		// Ugly last minute hack -
		coap_buffer[0] = 0x40;
		coap_buffer[1] = 0x02;
		coap_buffer[2] = 0x28;
		coap_buffer[3] = 0x90;
		coap_buffer[4] = 0xbb;
		coap_buffer[5] = 0x72;
		coap_buffer[6] = 0x65;
		coap_buffer[7] = 0x71;
		coap_buffer[8] = 0x75;
		coap_buffer[9] = 0x65;
		coap_buffer[10] = 0x73;
		coap_buffer[11] = 0x74;
		coap_buffer[12] = 0x2f;
		coap_buffer[13] = 0x75;
		coap_buffer[14] = 0x72;
		coap_buffer[15] = 0x69;
		coap_buffer[16] = 0xff;

		int header_len = 17;
		memcpy(&coap_buffer[17], buffer, len);
		remote_addr.sin_port = htons(DEFAULT_FOTA_COAP_PORT);
		net_addr_pton(AF_INET, CURRENT_COAP_BUFFER, &remote_addr.sin_addr);
		*/
		int err = sendto(sock, buffer, len, 0, (struct sockaddr *)&remote_addr, sizeof(remote_addr));
//		err = sendto(sock, coap_buffer, len+header_len, 0, (struct sockaddr *)&remote_addr, sizeof(remote_addr));
		if (err < 0)
		{
			LOG_ERR("Unable to send data: %d", err);
			k_sleep(5000);
			sys_reboot(0);
		}
		
		LOG_DBG("Done sending, sending again in %d seconds", SEND_INTERVAL_SEC);
		k_sleep(SEND_INTERVAL_SEC * K_MSEC(1000));

		fota_interval++;
		if (fota_interval > FOTA_COUNTER)
		{
			LOG_DBG("Check for new firmware");
			fota_interval = 0;
			if (fota_run())
			{
				k_sleep(1000);
			}
		}

		close (sock);

		// Force a reboot once a day. This wil implicitly trigger a new APN scan
		int uptime_seconds = k_uptime_get() / 1000;
		LOG_INF("Uptime: %d seconds", uptime_seconds);
		if (uptime_seconds > UPTIME_FORCE_REBOOT_LIMIT_SECONDS)
		{
			LOG_INF("REBOOTING");
			k_sleep(2000);
			sys_reboot(0);
		}
		
#if 0
			mb_dump_message(&last_message);
#endif
	}

}
```

## src/ads124s08.c
```c
/* --COPYRIGHT--,BSD
 * Copyright (c) 2016, Texas Instruments Incorporated
 * All rights reserved.
 *
 * Redistribution and use in source and binary forms, with or without
 * modification, are permitted provided that the following conditions
 * are met:
 *
 * *  Redistributions of source code must retain the above copyright
 *    notice, this list of conditions and the following disclaimer.
 *
 * *  Redistributions in binary form must reproduce the above copyright
 *    notice, this list of conditions and the following disclaimer in the
 *    documentation and/or other materials provided with the distribution.
 *
 * *  Neither the name of Texas Instruments Incorporated nor the names of
 *    its contributors may be used to endorse or promote products derived
 *    from this software without specific prior written permission.
 *
 * THIS SOFTWARE IS PROVIDED BY THE COPYRIGHT HOLDERS AND CONTRIBUTORS "AS IS"
 * AND ANY EXPRESS OR IMPLIED WARRANTIES, INCLUDING, BUT NOT LIMITED TO,
 * THE IMPLIED WARRANTIES OF MERCHANTABILITY AND FITNESS FOR A PARTICULAR
 * PURPOSE ARE DISCLAIMED. IN NO EVENT SHALL THE COPYRIGHT OWNER OR
 * CONTRIBUTORS BE LIABLE FOR ANY DIRECT, INDIRECT, INCIDENTAL, SPECIAL,
 * EXEMPLARY, OR CONSEQUENTIAL DAMAGES (INCLUDING, BUT NOT LIMITED TO,
 * PROCUREMENT OF SUBSTITUTE GOODS OR SERVICES; LOSS OF USE, DATA, OR PROFITS;
 * OR BUSINESS INTERRUPTION) HOWEVER CAUSED AND ON ANY THEORY OF LIABILITY,
 * WHETHER IN CONTRACT, STRICT LIABILITY, OR TORT (INCLUDING NEGLIGENCE OR
 * OTHERWISE) ARISING IN ANY WAY OUT OF THE USE OF THIS SOFTWARE,
 * EVEN IF ADVISED OF THE POSSIBILITY OF SUCH DAMAGE.
 * --/COPYRIGHT--*/

#include <zephyr.h>
#include <drivers/spi.h>
#include <device.h>
#include <stdio.h>
#include "spi_config.h"
#include "ads124s08.h"
#include <drivers/gpio.h>
#include "gpio.h"
#include "opc_n3.h"
#include "messagebuffer.h"

#define LOG_LEVEL CONFIG_ADSL_LOG_LEVEL
#include <logging/log.h>
LOG_MODULE_REGISTER(ADS123S08);

uint8_t ADS124S08__drdy_pin;
uint8_t ADS124S08__start_pin;
uint8_t ADS124S08__reset_pin;
struct spi_config ADS124S08_config;
struct spi_cs_control ADS124S08_control;
struct spi_buf ADS124S08_buf_tx;
struct spi_buf_set ADS124S08_buf_set_tx;
struct spi_buf ADS124S08_buf_rx;
struct spi_buf_set ADS124S08_buf_set_rx;
struct device *ADS124S08_spi_dev;

u8_t ADS124S08_spi_tx_buffer[SPI_BUF_SIZE];
u8_t ADS124S08_spi_rx_buffer[SPI_BUF_SIZE];

// TODO(stalehd): Might not need this
#define CS_DWELL_TIME_MS 1

void ADS124S08_select(void)
{
	digitalWrite(CS_PIN, LOW);
	k_sleep(CS_DWELL_TIME_MS);
}

void ADS124S08_release(void)
{
	digitalWrite(CS_PIN, HIGH);
	k_sleep(CS_DWELL_TIME_MS);
}

void ADS124S08_init(void)
{
	LOG_INF("ADS124S08_init");
	ADS124S08_release();
	ADS124S08_stopConversion();
}

static int counter = 0;

void ADS124S08_begin()
{
	LOG_DBG("ADS124S08_begin %d", counter++);
	ADS124S08_config.cs = NULL;
	ADS124S08_config.frequency = 1000000;
	ADS124S08_config.operation = SPI_OP_MODE_MASTER | SPI_WORD_SET(8) | SPI_TRANSFER_MSB | SPI_MODE_CPHA;
	ADS124S08_config.slave = 0;
	ADS124S08_spi_dev = get_SPI_device();
	if (!ADS124S08_spi_dev)
	{
		LOG_ERR("SPI device driver not found");
		return;
	}

	LOG_DBG("ADS124S08_config cs: %d", (int)ADS124S08_config.cs);
	LOG_DBG("ADS124S08_config frequency: %d", (int)ADS124S08_config.frequency);
	LOG_DBG("ADS124S08_config operation: %d", (int)ADS124S08_config.operation);
	LOG_DBG("ADS124S08_config slave: %d", (int)ADS124S08_config.slave);
}

// Reads a single register contents from the specified address
//
// \param regnum identifies which address to read
//
char ADS124S08_regRead(unsigned int regnum)
{
	LOG_DBG("ADS124S08_regRead - register: %d", regnum);
	ADS124S08_spi_tx_buffer[0] = REGRD_OPCODE_MASK + (regnum & 0x1f);
	ADS124S08_spi_tx_buffer[1] = 0x00;
	ADS124S08_spi_tx_buffer[2] = 0x00;

	ADS124S08_spi_rx_buffer[0] = 0x00;
	ADS124S08_spi_rx_buffer[1] = 0x00;
	ADS124S08_spi_rx_buffer[2] = 0x00;

	ADS124S08_buf_tx.buf = &ADS124S08_spi_tx_buffer;
	ADS124S08_buf_tx.len = 3;
	ADS124S08_buf_set_tx.buffers = &ADS124S08_buf_tx;
	ADS124S08_buf_set_tx.count = 1;

	ADS124S08_buf_rx.buf = &ADS124S08_spi_rx_buffer;
	ADS124S08_buf_rx.len = 3;
	ADS124S08_buf_set_rx.buffers = &ADS124S08_buf_rx;
	ADS124S08_buf_set_rx.count = 1;

	ADS124S08_select();
	int err = spi_transceive(ADS124S08_spi_dev, &ADS124S08_config, &ADS124S08_buf_set_tx, &ADS124S08_buf_set_rx);
	if (err)
	{
		LOG_ERR("ADS124S08_regRead failed. Writing to register: %02X", ADS124S08_spi_tx_buffer[0]);
	}
	ADS124S08_release();

	LOG_DBG("ADS124S08_regRead tx: %02x %02x %02x", ADS124S08_spi_tx_buffer[0],
			ADS124S08_spi_tx_buffer[1],
			ADS124S08_spi_tx_buffer[2]);
	LOG_DBG("ADS124S08_regRead rx: %02x %02x %02x", ADS124S08_spi_rx_buffer[0],
			ADS124S08_spi_rx_buffer[1],
			ADS124S08_spi_rx_buffer[2]);

	return ADS124S08_spi_rx_buffer[2];
}

//
//  Reads a group of registers starting at the specified address
//
//  \param regnum is addr_mask 8-bit mask of the register from which we start reading
//  \param count The number of registers we wish to read
//  \param *location pointer to the location in memory to write the data
//
void ADS124S08_readRegs(unsigned int regnum, unsigned int count, uint8_t *data)
{
	ADS124S08_spi_tx_buffer[0] = REGRD_OPCODE_MASK + (regnum & 0x1f);
	ADS124S08_spi_tx_buffer[1] = count - 1;

	ADS124S08_buf_tx.buf = &ADS124S08_spi_tx_buffer;
	ADS124S08_buf_tx.len = 2;
	ADS124S08_buf_set_tx.buffers = &ADS124S08_buf_tx;
	ADS124S08_buf_set_tx.count = 1;

	ADS124S08_buf_rx.buf = &ADS124S08_spi_rx_buffer;
	ADS124S08_buf_rx.len = 2;
	ADS124S08_buf_set_rx.buffers = &ADS124S08_buf_rx;
	ADS124S08_buf_set_rx.count = 1;

	ADS124S08_select();
	int err = spi_transceive(ADS124S08_spi_dev, &ADS124S08_config, &ADS124S08_buf_set_tx, &ADS124S08_buf_set_rx);
	if (err)
	{
		LOG_ERR("ADS124S08_readRegs failed (1). Reading registers.");
	}

	memset(&ADS124S08_spi_tx_buffer[0], 0, SPI_BUF_SIZE);

	ADS124S08_buf_tx.len = count;
	ADS124S08_buf_rx.len = count;

	err = spi_transceive(ADS124S08_spi_dev, &ADS124S08_config, &ADS124S08_buf_set_tx, &ADS124S08_buf_set_rx);
	if (err)
	{
		LOG_ERR("ADS124S08_readRegs failed (2). Reading registers.");
	}

	ADS124S08_release();

	for (int i = 0; i < count; i++)
	{
		LOG_DBG("regRead reg: %d: value: %d\n", i, (int)ADS124S08_spi_rx_buffer[i]);
		data[i] = ADS124S08_spi_rx_buffer[i];
	}
}

//
//  Writes a single of register with the specified data
//
//  \param regnum addr_mask 8-bit mask of the register to which we start writing
//  \param data to be written
//
void ADS124S08_regWrite(unsigned int regnum, unsigned char data)
{
	ADS124S08_spi_tx_buffer[0] = REGWR_OPCODE_MASK + (regnum & 0x1f);
	ADS124S08_spi_tx_buffer[1] = 0x00;
	ADS124S08_spi_tx_buffer[2] = data;

	ADS124S08_buf_tx.buf = &ADS124S08_spi_tx_buffer;
	ADS124S08_buf_tx.len = 3;
	ADS124S08_buf_set_tx.buffers = &ADS124S08_buf_tx;
	ADS124S08_buf_set_tx.count = 1;

	ADS124S08_select();
	int err = spi_write(ADS124S08_spi_dev, &ADS124S08_config, &ADS124S08_buf_set_tx);
	if (err)
	{
		LOG_ERR("ADS124S08_regWrite. Writing to register: %02X value: %d", regnum, data);
	}
	ADS124S08_release();
}

//  Sends a command to the ADS124S08
//
//  \param op_code is the command being issued
//
void ADS124S08_sendCommand(uint8_t op_code)
{
	ADS124S08_spi_tx_buffer[0] = op_code;
	ADS124S08_spi_rx_buffer[0] = 0x00;

	ADS124S08_buf_tx.buf = &ADS124S08_spi_tx_buffer;
	ADS124S08_buf_tx.len = 1;
	ADS124S08_buf_set_tx.buffers = &ADS124S08_buf_tx;
	ADS124S08_buf_set_tx.count = 1;

	ADS124S08_buf_rx.buf = &ADS124S08_spi_rx_buffer;
	ADS124S08_buf_rx.len = 1;
	ADS124S08_buf_set_rx.buffers = &ADS124S08_buf_rx;
	ADS124S08_buf_set_rx.count = 1;

	ADS124S08_select();

	int err = spi_transceive(ADS124S08_spi_dev, &ADS124S08_config, &ADS124S08_buf_set_tx, &ADS124S08_buf_set_rx);
	if (err)
	{
		LOG_ERR("ADS124S08__sendCommand failed. opcode: %02X", op_code);
	}

	ADS124S08_release();
}

#define MAGIC_TIME_TO_SLEEP_AFTER_RESTART 100

//  Sends a STOP/START command sequence to the ADS124S08 to restart conversions (SYNC)
//
void ADS124S08_reStart(void)
{
	ADS124S08_sendCommand(STOP_OPCODE_MASK);
	ADS124S08_sendCommand(START_OPCODE_MASK);
	k_sleep(MAGIC_TIME_TO_SLEEP_AFTER_RESTART);

	return;
}

//  Sets the GPIO hardware START pin high (red LED)
//
void ADS124S08_startConversion()
{
	digitalWrite(START_PIN, HIGH);
	k_sleep(CS_DWELL_TIME_MS);
}

//  Sets the GPIO hardware START pin low
//
void ADS124S08_stopConversion()
{
	digitalWrite(START_PIN, LOW);
	k_sleep(CS_DWELL_TIME_MS);
}

// TODO(stalehd): Might not need that
#define RESET_DWELL_TIME_MS 200
void ADS124S08_hardReset()
{
	gpio_pin_write(get_GPIO_device(), ADC_RESET, 0);
	k_sleep(RESET_DWELL_TIME_MS);
	gpio_pin_write(get_GPIO_device(), ADC_RESET, 1);
	k_sleep(RESET_DWELL_TIME_MS);
}

//  Read the last conversion result
//
unsigned int ADS124S08_dataRead(uint8_t *status, uint8_t *crc)
{
	uint8_t xcrc;
	uint8_t xstatus;
	unsigned int iData;
	ADS124S08_select();

	ADS124S08_spi_tx_buffer[0] = 0x00;
	ADS124S08_spi_rx_buffer[0] = 0x00;
	ADS124S08_buf_tx.buf = &ADS124S08_spi_tx_buffer;
	ADS124S08_buf_tx.len = 1;
	ADS124S08_buf_set_tx.buffers = &ADS124S08_buf_tx;
	ADS124S08_buf_set_tx.count = 1;

	ADS124S08_buf_rx.buf = &ADS124S08_spi_rx_buffer;
	ADS124S08_buf_rx.len = 1;
	ADS124S08_buf_set_rx.buffers = &ADS124S08_buf_rx;
	ADS124S08_buf_set_rx.count = 1;

	int err = spi_transceive(ADS124S08_spi_dev, &ADS124S08_config, &ADS124S08_buf_set_tx, &ADS124S08_buf_set_rx);
	if (err)
	{
		LOG_ERR("ADS124S08_dataRead failed (conversion 1).");
	}
	xstatus = ADS124S08_spi_rx_buffer[0];
	// LOG_INF("ADS124S08_dataRead xstatus: %d", xstatus);
	status[0] = (uint8_t)xstatus;

	ADS124S08_spi_tx_buffer[0] = 0x00;
	ADS124S08_spi_tx_buffer[1] = 0x00;
	ADS124S08_spi_tx_buffer[2] = 0x00;
	ADS124S08_spi_rx_buffer[0] = 0x00;
	ADS124S08_spi_rx_buffer[1] = 0x00;
	ADS124S08_spi_rx_buffer[2] = 0x00;
	ADS124S08_buf_tx.buf = &ADS124S08_spi_tx_buffer;
	ADS124S08_buf_tx.len = 3;
	ADS124S08_buf_set_tx.buffers = &ADS124S08_buf_tx;
	ADS124S08_buf_set_tx.count = 1;

	ADS124S08_buf_rx.buf = &ADS124S08_spi_rx_buffer;
	ADS124S08_buf_rx.len = 3;
	ADS124S08_buf_set_rx.buffers = &ADS124S08_buf_rx;
	ADS124S08_buf_set_rx.count = 1;

	err = spi_transceive(ADS124S08_spi_dev, &ADS124S08_config, &ADS124S08_buf_set_tx, &ADS124S08_buf_set_rx);
	if (err)
	{
		LOG_ERR("ADS124S08_dataRead failed (conversion 2).");
	}

	// get the conversion data (3 bytes)
	uint8_t data[3];
	data[0] = ADS124S08_spi_rx_buffer[0];
	data[1] = ADS124S08_spi_rx_buffer[1];
	data[2] = ADS124S08_spi_rx_buffer[2];

	iData = data[0];
	iData = (iData << 8) + data[1];
	iData = (iData << 8) + data[2];

	// Read the CRC
	ADS124S08_spi_tx_buffer[0] = 0x00;
	ADS124S08_spi_rx_buffer[0] = 0x00;
	ADS124S08_buf_tx.buf = &ADS124S08_spi_tx_buffer;
	ADS124S08_buf_tx.len = 1;
	ADS124S08_buf_set_tx.buffers = &ADS124S08_buf_tx;
	ADS124S08_buf_set_tx.count = 1;

	ADS124S08_buf_rx.buf = &ADS124S08_spi_rx_buffer;
	ADS124S08_buf_rx.len = 1;
	ADS124S08_buf_set_rx.buffers = &ADS124S08_buf_rx;
	ADS124S08_buf_set_rx.count = 1;

	err = spi_transceive(ADS124S08_spi_dev, &ADS124S08_config, &ADS124S08_buf_set_tx, &ADS124S08_buf_set_rx);
	if (err)
	{
		LOG_ERR("ADS124S08_dataRead failed (conversion 3).");
	}
	xcrc = ADS124S08_spi_rx_buffer[0];
	crc[0] = (uint8_t)xcrc;

	ADS124S08_release();
	return iData;
}

void configureAdc(unsigned char channel)
{
	ADS124S08_sendCommand(WAKE_OPCODE_MASK);
	ADS124S08_regWrite(INPMUX_ADDR_MASK, channel | ADS_N_AINCOM);
	ADS124S08_regWrite(PGA_ADDR_MASK, 0b00000000);
	ADS124S08_regWrite(REF_ADDR_MASK, 0b00110000);
	ADS124S08_regWrite(SYS_ADDR_MASK, 0b00000011);
	ADS124S08_reStart();
}

unsigned int sampleChannel(unsigned char channel)
{
	uint8_t status = 0;
	uint8_t crc = 0;

	configureAdc(channel);

	ADS124S08_startConversion();
	unsigned int data = ADS124S08_dataRead(&status, &crc);
	ADS124S08_stopConversion();
	bool valid = ~(status & DEVICE_READY_FLAG);
	if (!valid)
	{
		LOG_ERR("ADC not ready while sampling channel: %c", channel);
	}
	//		 printf("ADC (2's): %u , status :%d, crc: %d - valid: %s\n", data, status, crc, (valid ? "YES" : "NO"));

	return data;
}

static AFE3_SAMPLE current;

void adc_sample_data()
{
	current.op1 = sampleChannel(ADS_P_AIN0);
	current.op2 = sampleChannel(ADS_P_AIN1);
	current.op3 = sampleChannel(ADS_P_AIN2);
	current.op4 = sampleChannel(ADS_P_AIN3);
	current.op5 = sampleChannel(ADS_P_AIN4);
	current.op6 = sampleChannel(ADS_P_AIN5);
	current.pt = sampleChannel(ADS_P_AIN8);
}

void adc_get_sample(AFE3_SAMPLE *msg)
{
	memcpy(msg, &current, sizeof(current));
}
```

## src/ads124s08.h
```c
/* --COPYRIGHT--,BSD
 * Copyright (c) 2016, Texas Instruments Incorporated
 * All rights reserved.
 *
 * Redistribution and use in source and binary forms, with or without
 * modification, are permitted provided that the following conditions
 * are met:
 *
 * *  Redistributions of source code must retain the above copyright
 *    notice, this list of conditions and the following disclaimer.
 *
 * *  Redistributions in binary form must reproduce the above copyright
 *    notice, this list of conditions and the following disclaimer in the
 *    documentation and/or other materials provided with the distribution.
 *
 * *  Neither the name of Texas Instruments Incorporated nor the names of
 *    its contributors may be used to endorse or promote products derived
 *    from this software without specific prior written permission.
 *
 * THIS SOFTWARE IS PROVIDED BY THE COPYRIGHT HOLDERS AND CONTRIBUTORS "AS IS"
 * AND ANY EXPRESS OR IMPLIED WARRANTIES, INCLUDING, BUT NOT LIMITED TO,
 * THE IMPLIED WARRANTIES OF MERCHANTABILITY AND FITNESS FOR A PARTICULAR
 * PURPOSE ARE DISCLAIMED. IN NO EVENT SHALL THE COPYRIGHT OWNER OR
 * CONTRIBUTORS BE LIABLE FOR ANY DIRECT, INDIRECT, INCIDENTAL, SPECIAL,
 * EXEMPLARY, OR CONSEQUENTIAL DAMAGES (INCLUDING, BUT NOT LIMITED TO,
 * PROCUREMENT OF SUBSTITUTE GOODS OR SERVICES; LOSS OF USE, DATA, OR PROFITS;
 * OR BUSINESS INTERRUPTION) HOWEVER CAUSED AND ON ANY THEORY OF LIABILITY,
 * WHETHER IN CONTRACT, STRICT LIABILITY, OR TORT (INCLUDING NEGLIGENCE OR
 * OTHERWISE) ARISING IN ANY WAY OUT OF THE USE OF THIS SOFTWARE,
 * EVEN IF ADVISED OF THE POSSIBILITY OF SUCH DAMAGE.
 * --/COPYRIGHT--*/
/*
 * ADS124S08.h
 *
 */

#pragma once

#include "pinout.h"

// Start definitions
#define NUM_REGISTERS 18

//  Address masks used for register addressing with
//  either a REGRD of REGWR mask
#define ID_ADDR_MASK 0x00
#define STATUS_ADDR_MASK 0x01
#define INPMUX_ADDR_MASK 0x02
#define PGA_ADDR_MASK 0x03
#define DATARATE_ADDR_MASK 0x04
#define REF_ADDR_MASK 0x05
#define IDACMAG_ADDR_MASK 0x06
#define IDACMUX_ADDR_MASK 0x07
#define VBIAS_ADDR_MASK 0x08
#define SYS_ADDR_MASK 0x09
#define OFCAL0_ADDR_MASK 0x0A
#define OFCAL1_ADDR_MASK 0x0B
#define OFCAL2_ADDR_MASK 0x0C
#define FSCAL0_ADDR_MASK 0x0D
#define FSCAL1_ADDR_MASK 0x0E
#define FSCAL2_ADDR_MASK 0x0F
#define GPIODAT_ADDR_MASK 0x10
#define GPIOCON_ADDR_MASK 0x11

// Opcode masks (or "Commands" if you will...)
#define NOP_OPCODE_MASK 0x00
#define WAKE_OPCODE_MASK 0x02
#define SLEEP_OPCODE_MASK 0x04
#define RESET_OPCODE_MASK 0x06
#define START_OPCODE_MASK 0x08
#define STOP_OPCODE_MASK 0x0A
#define SFOCAL_OPCODE_MASK 0x19
#define SYOCAL_OPCODE_MASK 0x16
#define SYGCAL_OPCODE_MASK 0x17
#define RDATA_OPCODE_MASK 0x12
#define REGRD_OPCODE_MASK 0x20
#define REGWR_OPCODE_MASK 0x40

/* Register sub masks */
/* ADS124S08 Register 0 (ID) Definition
 *   Bit 7   |   Bit 6   |   Bit 5   |   Bit 4   |   Bit 3   |   Bit 2   |   Bit 1   |   Bit 0
 *--------------------------------------------------------------------------------------------
 *        			RESERVED[4:0]      			 			 |  	      DEV_ID[2:0]
 *
 */
/* Define ID (revision) */
#define ADS_ID_A 0x00
#define ADS_ID_B 0x80
/* Define VER (device version) */
#define ADS_124S08 0x00
#define ADS_124S06 0x01
#define ADS_114S08 0x04
#define ADS_114S06 0x05
/* ADS124S08 Register 1 (STATUS) Definition */
/*   Bit 7   |   Bit 6   |   Bit 5   |   Bit 4   |   Bit 3   |   Bit 2   |   Bit 1   |   Bit 0
 *--------------------------------------------------------------------------------------------
 *   FL_POR  |    nRDY   | FL_P_RAILP| FL_P_RAILN| FL_N_RAILP| FL_N_RAILN| FL_REF_L1 | FL_REF_L0
 *
 */
#define ADS_FL_POR 0x80
#define ADS_RDY 0x40
#define ADS_FL_P_RAILP 0x20
#define ADS_FL_P_RAILN 0x10
#define ADS_FL_N_RAILP 0x08
#define ADS_FL_N_RAILN 0x04
#define ADS_FL_REF_L1 0x02
#define ADS_FL_REF_L0 0x10
/* ADS124S08 Register 2 (INPMUX) Definition */
/*   Bit 7   |   Bit 6   |   Bit 5   |   Bit 4   |   Bit 3   |   Bit 2   |   Bit 1   |   Bit 0
 *--------------------------------------------------------------------------------------------
 *         			MUXP[3:0]   				 |       			MUXN[3:0]
 *
 */
/* Define the ADC positive input channels (MUXP) */
#define ADS_P_AIN0 (0b0000 << 4)
#define ADS_P_AIN1 (0b0001 << 4)
#define ADS_P_AIN2 (0b0010 << 4)
#define ADS_P_AIN3 (0b0011 << 4)
#define ADS_P_AIN4 (0b0100 << 4)
#define ADS_P_AIN5 (0b0101 << 4)
#define ADS_P_AIN6 (0b0110 << 4)
#define ADS_P_AIN7 (0b0111 << 4)
#define ADS_P_AIN8 (0b1000 << 4)
#define ADS_P_AIN9 (0b1001 << 4)
#define ADS_P_AIN10 (0b1010 << 4)
#define ADS_P_AIN11 (0b1011 << 4)
#define ADS_P_AINCOM (0b1100 << 4)
/* Define the ADC negative input channels (MUXN)*/
#define ADS_N_AIN0 0b0000
#define ADS_N_AIN1 0b0001
#define ADS_N_AIN2 0b0010
#define ADS_N_AIN3 0b0011
#define ADS_N_AIN4 0b0100
#define ADS_N_AIN5 0b0101
#define ADS_N_AIN6 0b0110
#define ADS_N_AIN7 0b0111
#define ADS_N_AIN8 0b1000
#define ADS_N_AIN9 0b1001
#define ADS_N_AIN10 0b1010
#define ADS_N_AIN11 0b1011
#define ADS_N_AINCOM 0b1100
/* ADS124S08 Register 3 (PGA) Definition */
/*   Bit 7   |   Bit 6   |   Bit 5   |   Bit 4   |   Bit 3   |   Bit 2   |   Bit 1   |   Bit 0
 *--------------------------------------------------------------------------------------------
 *   		DELAY[2:0]		     	 |      PGA_EN[1:0]      |              GAIN[2:0]
 *
 */
/* Define conversion delay in tmod clock periods */
#define ADS_DELAY_14 0x00
#define ADS_DELAY_25 0x20
#define ADS_DELAY_64 0x40
#define ADS_DELAY_256 0x60
#define ADS_DELAY_1024 0x80
#define ADS_DELAY_2048 0xA0
#define ADS_DELAY_4096 0xC0
#define ADS_DELAY_1 0xE0
/* Define PGA control */
#define ADS_PGA_BYPASS 0x00
#define ADS_PGA_ENABLED 0x08
/* Define Gain */
#define ADS_GAIN_1 0x00
#define ADS_GAIN_2 0x01
#define ADS_GAIN_4 0x02
#define ADS_GAIN_8 0x03
#define ADS_GAIN_16 0x04
#define ADS_GAIN_32 0x05
#define ADS_GAIN_64 0x06
#define ADS_GAIN_128 0x07
/* ADS124S08 Register 4 (DATARATE) Definition */
/*   Bit 7   |   Bit 6   |   Bit 5   |   Bit 4   |   Bit 3   |   Bit 2   |   Bit 1   |   Bit 0
 *--------------------------------------------------------------------------------------------
 *   G_CHOP  |    CLK    |    MODE   |   FILTER  | 				  DR[3:0]
 *
 */
#define ADS_GLOBALCHOP 0x80
#define ADS_CLKSEL_EXT 0x40
#define ADS_CONVMODE_SS 0x20
#define ADS_FILTERTYPE_LL 0x10
/* Define the data rate */
#define ADS_DR_2_5 0x00
#define ADS_DR_5 0x01
#define ADS_DR_10 0x02
#define ADS_DR_16 0x03
#define ADS_DR_20 0x04
#define ADS_DR_50 0x05
#define ADS_DR_60 0x06
#define ADS_DR_100 0x07
#define ADS_DR_200 0x08
#define ADS_DR_400 0x09
#define ADS_DR_800 0x0A
#define ADS_DR_1000 0x0B
#define ADS_DR_2000 0x0C
#define ADS_DR_4000 0x0D
/* ADS124S08 Register 5 (REF) Definition */
/*   Bit 7   |   Bit 6   |   Bit 5   |   Bit 4   |   Bit 3   |   Bit 2   |   Bit 1   |   Bit 0
 *--------------------------------------------------------------------------------------------
 *	  FL_REF_EN[1:0]	 | nREFP_BUF | nREFN_BUF | 		REFSEL[1:0]		 | 		REFCON[1:0]
 *
 */
#define ADS_FLAG_REF_DISABLE 0x00
#define ADS_FLAG_REF_EN_L0 0x40
#define ADS_FLAG_REF_EN_BOTH 0x80
#define ADS_FLAG_REF_EN_10M 0xC0
#define ADS_REFP_BYP_DISABLE 0x20
#define ADS_REFP_BYP_ENABLE 0x00
#define ADS_REFN_BYP_DISABLE 0x10
#define ADS_REFN_BYP_ENABLE 0x00
#define ADS_REFSEL_P0 0x00
#define ADS_REFSEL_P1 0x04
#define ADS_REFSEL_INT 0x08
#define ADS_REFINT_OFF 0x00
#define ADS_REFINT_ON_PDWN 0x01
#define ADS_REFINT_ON_ALWAYS 0x02
/* ADS124S08 Register 6 (IDACMAG) Definition */
/*   Bit 7   |   Bit 6   |   Bit 5   |   Bit 4   |   Bit 3   |   Bit 2   |   Bit 1   |   Bit 0
 *--------------------------------------------------------------------------------------------
 * FL_RAIL_EN|	  PSW	 |     0     | 		0	 | 			    	IMAG[3:0]
 *
 */
#define ADS_FLAG_RAIL_ENABLE 0x80
#define ADS_FLAG_RAIL_DISABLE 0x00
#define ADS_PSW_OPEN 0x00
#define ADS_PSW_CLOSED 0x40
#define ADS_IDACMAG_OFF 0x00
#define ADS_IDACMAG_10 0x01
#define ADS_IDACMAG_50 0x02
#define ADS_IDACMAG_100 0x03
#define ADS_IDACMAG_250 0x04
#define ADS_IDACMAG_500 0x05
#define ADS_IDACMAG_750 0x06
#define ADS_IDACMAG_1000 0x07
#define ADS_IDACMAG_1500 0x08
#define ADS_IDACMAG_2000 0x09
/* ADS124S08 Register 7 (IDACMUX) Definition */
/*   Bit 7   |   Bit 6   |   Bit 5   |   Bit 4   |   Bit 3   |   Bit 2   |   Bit 1   |   Bit 0
 *--------------------------------------------------------------------------------------------
 *                    I2MUX[3:0]                 |                   I1MUX[3:0]
 *
 */
/* Define IDAC2 Output */
#define ADS_IDAC2_A0 0x00
#define ADS_IDAC2_A1 0x10
#define ADS_IDAC2_A2 0x20
#define ADS_IDAC2_A3 0x30
#define ADS_IDAC2_A4 0x40
#define ADS_IDAC2_A5 0x50
#define ADS_IDAC2_A6 0x60
#define ADS_IDAC2_A7 0x70
#define ADS_IDAC2_A8 0x80
#define ADS_IDAC2_A9 0x90
#define ADS_IDAC2_A10 0xA0
#define ADS_IDAC2_A11 0xB0
#define ADS_IDAC2_AINCOM 0xC0
#define ADS_IDAC2_OFF 0xF0
/* Define IDAC1 Output */
#define ADS_IDAC1_A0 0x00
#define ADS_IDAC1_A1 0x01
#define ADS_IDAC1_A2 0x02
#define ADS_IDAC1_A3 0x03
#define ADS_IDAC1_A4 0x04
#define ADS_IDAC1_A5 0x05
#define ADS_IDAC1_A6 0x06
#define ADS_IDAC1_A7 0x07
#define ADS_IDAC1_A8 0x08
#define ADS_IDAC1_A9 0x09
#define ADS_IDAC1_A10 0x0A
#define ADS_IDAC1_A11 0x0B
#define ADS_IDAC1_AINCOM 0x0C
#define ADS_IDAC1_OFF 0x0F
/* ADS124S08 Register 8 (VBIAS) Definition */
/*   Bit 7   |   Bit 6   |   Bit 5   |   Bit 4   |   Bit 3   |   Bit 2   |   Bit 1   |   Bit 0
 *--------------------------------------------------------------------------------------------
 *  VB_LEVEL | 	VB_AINC  |  VB_AIN5  |  VB_AIN4  |  VB_AIN3  |  VB_AIN2  |  VB_AIN1  |  VB_AIN0
 *
 */
#define ADS_VBIAS_LVL_DIV2 0x00
#define ADS_VBIAS_LVL_DIV12 0x80
/* Define VBIAS here */
#define ADS_VB_AINC 0x40
#define ADS_VB_AIN5 0x20
#define ADS_VB_AIN4 0x10
#define ADS_VB_AIN3 0x08
#define ADS_VB_AIN2 0x04
#define ADS_VB_AIN1 0x02
#define ADS_VB_AIN0 0x01
/* ADS124S08 Register 9 (SYS) Definition */
/*   Bit 7   |   Bit 6   |   Bit 5   |   Bit 4   |   Bit 3   |   Bit 2   |   Bit 1   |   Bit 0
 *--------------------------------------------------------------------------------------------
 *			   SYS_MON[2:0]			 |	   CAL_SAMP[1:0]     |  TIMEOUT  | 	  CRC	 | SENDSTAT
 *
 */
#define ADS_SYS_MON_OFF 0x00
#define ADS_SYS_MON_SHORT 0x20
#define ADS_SYS_MON_TEMP 0x40
#define ADS_SYS_MON_ADIV4 0x60
#define ADS_SYS_MON_DDIV4 0x80
#define ADS_SYS_MON_BCS_2 0xA0
#define ADS_SYS_MON_BCS_1 0xC0
#define ADS_SYS_MON_BCS_10 0xE0
#define ADS_CALSAMPLE_1 0x00
#define ADS_CALSAMPLE_4 0x08
#define ADS_CALSAMPLE_8 0x10
#define ADS_CALSAMPLE_16 0x18
#define ADS_TIMEOUT_DISABLE 0x00
#define ADS_TIMEOUT_ENABLE 0x04
#define ADS_CRC_DISABLE 0x00
#define ADS_CRC_ENABLE 0x02
#define ADS_SENDSTATUS_DISABLE 0x00
#define ADS_SENDSTATUS_ENABLE 0x01
/* ADS124S08 Register A (OFCAL0) Definition */
/*   Bit 7   |   Bit 6   |   Bit 5   |   Bit 4   |   Bit 3   |   Bit 2   |   Bit 1   |   Bit 0
 *--------------------------------------------------------------------------------------------
 *                                         OFC[7:0]
 *
 */
/* ADS124S08 Register B (OFCAL1) Definition */
/*   Bit 7   |   Bit 6   |   Bit 5   |   Bit 4   |   Bit 3   |   Bit 2   |   Bit 1   |   Bit 0
 *--------------------------------------------------------------------------------------------
 *                                         OFC[15:8]
 *
 */
/* ADS124S08 Register C (OFCAL2) Definition */
/*   Bit 7   |   Bit 6   |   Bit 5   |   Bit 4   |   Bit 3   |   Bit 2   |   Bit 1   |   Bit 0
 *--------------------------------------------------------------------------------------------
 *                                         OFC[23:16]
 *
 */
/* ADS124S08 Register D (FSCAL0) Definition */
/*   Bit 7   |   Bit 6   |   Bit 5   |   Bit 4   |   Bit 3   |   Bit 2   |   Bit 1   |   Bit 0
 *--------------------------------------------------------------------------------------------
 *                                         FSC[7:0]
 *
 */
/* ADS124S08 Register E (FSCAL1) Definition */
/*   Bit 7   |   Bit 6   |   Bit 5   |   Bit 4   |   Bit 3   |   Bit 2   |   Bit 1   |   Bit 0
 *--------------------------------------------------------------------------------------------
 *                                         FSC[15:8]
 *
 */
/* ADS124S08 Register F (FSCAL2) Definition */
/*   Bit 7   |   Bit 6   |   Bit 5   |   Bit 4   |   Bit 3   |   Bit 2   |   Bit 1   |   Bit 0
 *--------------------------------------------------------------------------------------------
 *                                         FSC[23:16]
 *
 */
/* ADS124S08 Register 10 (GPIODAT) Definition */
/*   Bit 7   |   Bit 6   |   Bit 5   |   Bit 4   |   Bit 3   |   Bit 2   |   Bit 1   |   Bit 0
 *--------------------------------------------------------------------------------------------
 *                      DIR[3:0]    			 | 					DAT[3:0]
 *
 */
/* Define GPIO direction (0-Output; 1-Input) here */
#define ADS_GPIO0_DIR_INPUT 0x10
#define ADS_GPIO1_DIR_INPUT 0x20
#define ADS_GPIO2_DIR_INPUT 0x40
#define ADS_GPIO3_DIR_INPUT 0x80
/*
 *
 */
/* Define GPIO data here */
/*
 *
 */
/* ADS124S08 Register 11 (GPIOCON) Definition */
/*   Bit 7   |   Bit 6   |   Bit 5   |   Bit 4   |   Bit 3   |   Bit 2   |   Bit 1   |   Bit 0
 *--------------------------------------------------------------------------------------------
 *     0	 |	   0	 |	   0	 |	   0     |                    CON[3:0]
 *
 */
/* Define GPIO configuration (0-Analog Input; 1-GPIO) here */
#define ADS_GPIO0_DIR_INPUT 0x10
#define ADS_GPIO1_DIR_INPUT 0x20
#define ADS_GPIO2_DIR_INPUT 0x40
#define ADS_GPIO3_DIR_INPUT 0x80
/*
 *
 */
/* Lengths of conversion data components */
#define DATA_LENGTH 3
#define STATUS_LENGTH 1
#define CRC_LENGTH 1
/*
 * The time we have to wait for the CS GPIO to actually
 * pull down before we start sending SCLKs
 *
 */
#define CHIP_SELECT_WAIT_TIME 0

/* Flag to signal that we are in the process of collecting data */
#define DATA_MODE_NORMAL 0x00
#define DATA_MODE_STATUS 0x01
#define DATA_MODE_CRC 0x02

/* The clock rate of the internal XTAL... */
#define DEVICE_ICLK 16384000

/* Set the SPI SCLK speed */
#define SPI_SPEED 5000000
/*
 * The TIVA has a 4 to 16 bit word size, to handle  32 bit words the TIVA needs to assemble
 * two groups of words together.  32 bits comprises of 2x16 words (or 4x8 words).
*/
#define SPI_WORD_SIZE 8

/* Chip select feedthrough GPIO - we hand feed chip select so overages may be pumped out. */
#define CS_PIN CS_ADC
#define DRDY_PIN -1
/* GPIO definitions. */
#define START_PIN ADC_SYNC
#define RESET_PIN ADC_RESET
#define CKEN_PIN -1

#define DEVICE_READY_FLAG 0b01000000

typedef struct
{
    unsigned int op1;
    unsigned int op2;
    unsigned int op3;
    unsigned int op4;
    unsigned int op5;
    unsigned int op6;
    unsigned int pt;
} AFE3_SAMPLE;

void ADS124S08_init(void);
void ADS124S08_begin();
char ADS124S08_regRead(unsigned int regnum);
void ADS124S08_readRegs(unsigned int regnum, unsigned int count, uint8_t *data);
void ADS124S08_regWrite(unsigned int regnum, unsigned char data);
void ADS124S08_reStart(void);
void ADS124S08_sendCommand(uint8_t op_code);
unsigned int ADS124S08_dataRead(uint8_t *dStatus, uint8_t *dCRC);
void ADS124S08_select(void);
void ADS124S08_release(void);
void ADS124S08_startConversion(void);
void ADS124S08_stopConversion(void);
void ADS124S08_assertClock(void);
void ADS124S08_deassertClock(void);

void adc_sample_data();

void adc_get_sample(AFE3_SAMPLE *msg);
```

## src/at_commands.h
```c
#pragma once

#include <stdio.h>
#include <stdlib.h>
#include <stdint.h>

#define AT_OK 0
#define AT_ERROR -1
#define AT_TIMEOUT -2

/**
 * @brief  Decode AT+NSORF response. The buffer is read in multiple chunks from
 *         the modem.
 * @return -1 for ERROR response, -2 for timeout, number of bytes decoded otherwise
 * @note   Will swallow URCs and call the appropriate callbacks. The lenght of
 *         the buffer must fit the number of bytes that is returned (it's set in
 *         the NSORF command)
 */
int atnsorf_decode(int *sockfd, char *ip, int *port, uint8_t *data, size_t *received, size_t *remaining);

/**
 * @brief Decode AT+CGPADDR response.
 * @return  0 for OK, -1 for ERROR response, -2 for timeout, lenght of address string otherwise
 * @note Will swallow URCs and call appropriate callbacks.  Address might be "0"
 */
int atcgpaddr_decode(char *address, size_t *len);

/**
 * @brief  Decode AT+NSOCR response. Reads until OK or ERROR is received.
 * @return socket file descriptor for modem, -1 for ERROR response, -2 for timeout
 * @note   Will swallow URCs and call the appropriate callbacks
 */
int atnsocr_decode(int *sockfd);

/**
 * @brief  Decode AT+NSOCL response. Reads until OK or ERROR is received.
 * @return 0 for OK, -1 for ERROR
 * @note   Will swallow URCs and call the appropriate callbacks
 */
int atnsocl_decode();

/**
 * @brief  Decode AT+NSOST response. Reads until OK or ERROR is received.
 * @return 0 for OK, -1 for ERROR, -2 for timeout
 * @note   Will swallow URCs and call the appropriate callbacks
 */
int atnsost_decode(int *sock_fd, size_t *sent);

/**
 * @brief Reads response from AT+NRB command. Reads until OK or ERROR is received.
 * @return 0 for OK, -1 for ERROR response, -2 for timeout, -3 for invalid input
 * @note  Will swallow URCs and call the appropriate callbacks
 */
int atnrb_decode();

/**
 * @brief decode AT+CIMI response from modem
 * @note buffer should have enough room for IMSIs (22 chars)
 */
int atcimi_decode(char *imsi);

/**
 * @brief decode AT+GCSN=1 response from modem
 * @note buffer should have enough room for IMEI (22 chars)
 */
int atcgsn_decode(char *imei);

/**
 * @brief decode AT+CPSMS response from modem.
 */
int atcpsms_decode();

/**
 * @brief generic decode function. Waits for OK, ERROR or timeout
 */
int at_generic_decode();
```

## src/atof.c
```c
/* 
 * atof.c --
 *
 *	Source code for the "atof" library procedure.
 *
 * Copyright 1988 Regents of the University of California
 * Permission to use, copy, modify, and distribute this
 * software and its documentation for any purpose and without
 * fee is hereby granted, provided that the above copyright
 * notice appear in all copies.  The University of California
 * makes no representations about the suitability of this
 * software for any purpose.  It is provided "as is" without
 * express or implied warranty.
 */

#include <stdlib.h>
#include <ctype.h>

#ifndef TRUE
#define TRUE 1
#define FALSE 0
#endif

static int maxExponent = 511;	/* Largest possible base 10 exponent.  Any
				 * exponent larger than this will already
				 * produce underflow or overflow, so there's
				 * no need to worry about additional digits.
				 */
static double powersOf10[] = {	/* Table giving binary powers of 10.  Entry */
    10.,			/* is 10^2^i.  Used to convert decimal */
    100.,			/* exponents into floating-point numbers. */
    1.0e4,
    1.0e8,
    1.0e16,
    1.0e32,
    1.0e64,
    1.0e128,
    1.0e256
};

/*
 *----------------------------------------------------------------------
 *
 * atof --
 *
 *	This procedure converts a floating-point number from an ASCII
 *	decimal representation to internal double-precision format.
 *
 * Results:
 *	The return value is the floating-point equivalent of string.
 *	If a terminating character is found before any floating-point
 *	digits, then zero is returned.
 *
 * Side effects:
 *	None.
 *
 *----------------------------------------------------------------------
 */

double
atof(string)
    char *string;		/* A decimal ASCII floating-point number,
				 * optionally preceded by white space.
				 * Must have form "-I.FE-X", where I is the
				 * integer part of the mantissa, F is the
				 * fractional part of the mantissa, and X
				 * is the exponent.  Either of the signs
				 * may be "+", "-", or omitted.  Either I
				 * or F may be omitted, or both.  The decimal
				 * point isn't necessary unless F is present.
				 * The "E" may actually be an "e".  E and X
				 * may both be omitted (but not just one).
				 */
{
    int sign, expSign = FALSE;
    double fraction, dblExp, *d;
    register char *p, c;
    int exp = 0;		/* Exponent read from "EX" field. */
    int fracExp = 0;		/* Exponent that derives from the fractional
				 * part.  Under normal circumstatnces, it is
				 * the negative of the number of digits in F.
				 * However, if I is very long, the last digits
				 * of I get dropped (otherwise a long I with a
				 * large negative exponent could cause an
				 * unnecessary overflow on I alone).  In this
				 * case, fracExp is incremented one for each
				 * dropped digit.
				 */
    int mantSize;		/* Number of digits in mantissa. */
    int decPt;			/* Number of mantissa digits BEFORE decimal
				 * point.
				 */
    char *pExp;			/* Temporarily holds location of exponent
				 * in string.
				 */

    /*
     * Strip off leading blanks and check for a sign.
     */

    p = string;
    while (isspace(*p)) {
	p += 1;
    }
    if (*p == '-') {
	sign = 	TRUE;
	p += 1;
    } else {
	if (*p == '+') {
	    p += 1;
	}
	sign = FALSE;
    }

    /*
     * Count the number of digits in the mantissa (including the decimal
     * point), and also locate the decimal point.
     */

    decPt = -1;
    for (mantSize = 0; ; mantSize += 1)
    {
	c = *p;
	if (!isdigit(c)) {
	    if ((c != '.') || (decPt >= 0)) {
		break;
	    }
	    decPt = mantSize;
	}
	p += 1;
    }

    /*
     * Now suck up the digits in the mantissa.  Use two integers to
     * collect 9 digits each (this is faster than using floating-point).
     * If the mantissa has more than 18 digits, ignore the extras, since
     * they can't affect the value anyway.
     */
    
    pExp  = p;
    p -= mantSize;
    if (decPt < 0) {
	decPt = mantSize;
    } else {
	mantSize -= 1;			/* One of the digits was the point. */
    }
    if (mantSize > 18) {
	fracExp = decPt - 18;
	mantSize = 18;
    } else {
	fracExp = decPt - mantSize;
    }
    if (mantSize == 0) {
	return 0.0;
    } else {
	int frac1, frac2;
	frac1 = 0;
	for ( ; mantSize > 9; mantSize -= 1)
	{
	    c = *p;
	    p += 1;
	    if (c == '.') {
		c = *p;
		p += 1;
	    }
	    frac1 = 10*frac1 + (c - '0');
	}
	frac2 = 0;
	for (; mantSize > 0; mantSize -= 1)
	{
	    c = *p;
	    p += 1;
	    if (c == '.') {
		c = *p;
		p += 1;
	    }
	    frac2 = 10*frac2 + (c - '0');
	}
	fraction = (1.0e9 * frac1) + frac2;
    }

    /*
     * Skim off the exponent.
     */

    p = pExp;
    if ((*p == 'E') || (*p == 'e')) {
	p += 1;
	if (*p == '-') {
	    expSign = TRUE;
	    p += 1;
	} else {
	    if (*p == '+') {
		p += 1;
	    }
	    expSign = FALSE;
	}
	while (isdigit(*p)) {
	    exp = exp * 10 + (*p - '0');
	    p += 1;
	}
    }
    if (expSign) {
	exp = fracExp - exp;
    } else {
	exp = fracExp + exp;
    }

    /*
     * Generate a floating-point number that represents the exponent.
     * Do this by processing the exponent one bit at a time to combine
     * many powers of 2 of 10. Then combine the exponent with the
     * fraction.
     */

    if (exp < 0) {
	expSign = TRUE;
	exp = -exp;
    } else {
	expSign = FALSE;
    }
    if (exp > maxExponent) {
	exp = maxExponent;
    }
    dblExp = 1.0;
    for (d = powersOf10; exp != 0; exp >>= 1, d += 1) {
	if (exp & 01) {
	    dblExp *= *d;
	}
    }
    if (expSign) {
	fraction /= dblExp;
    } else {
	fraction *= dblExp;
    }

    if (sign) {
	return -fraction;
    }
    return fraction;
}
```

## src/atof.h
```c
#ifndef _ATOF_H_
#define _ATOF_H_

double atof(char *string);

#endif
```
